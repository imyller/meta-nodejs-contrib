## conf/layer.conf
```bitbake
# We have a conf and classes directory, append to BBPATH
BBPATH .= ":${LAYERDIR}"

# We have a recipes directory, add to BBFILES
BBFILES += "${LAYERDIR}/recipes*/*/*.bb ${LAYERDIR}/recipes*/*/*.bbappend"

BBFILE_COLLECTIONS += "nodejs-contrib"
BBFILE_PATTERN_nodejs-contrib := "^${LAYERDIR}/"
BBFILE_PRIORITY_nodejs-contrib = "48"

LAYERDEPENDS_nodejs-contrib = "core nodejs"
```
